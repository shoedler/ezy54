## boards/shields/shoedler54/Kconfig.shield
```kconfig
config SHIELD_SHOEDLER54_LEFT
    def_bool $(shields_list_contains,ezy54_left)

config SHIELD_SHOEDLER54_RIGHT
    def_bool $(shields_list_contains,ezy54_right)
```
